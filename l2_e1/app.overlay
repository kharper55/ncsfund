/ {
    aliases {
        sw0 = &sw0;
    };

    switches {
        compatible = "gpio-keys";

        sw0: sw_0 {
            gpios = <&gpio0 17 GPIO_ACTIVE_HIGH>;
            label = "SW0";
        };
    };
};
